## patches/hid-razer/driver/Kconfig
```kconfig
config HID_RAZER_DFUSE
	tristate "DFUSE Razer HID support"
	depends on HID && USB
	help
	  Built-in DFUSE support for Razer keyboards and mice using
	  driver sources adapted from OpenRazer.
```

## patches/xbox/driver/xpadneo/src/Kconfig
```kconfig
# SPDX-License-Identifier: GPL-2.0-only

config HID_XPADNEO_DFUSE
	tristate "DFUSE xpadneo Bluetooth Xbox controller support"
	depends on HID
	depends on BT
	depends on INPUT
	select INPUT_FF_MEMLESS
	help
	  Enable the DFUSE-integrated xpadneo driver for Xbox One,
	  Xbox Elite and Xbox Series controllers connected over Bluetooth.

	  The driver includes rumble, battery reporting, controller mappings
	  and support for compatible Bluetooth Xbox-style controllers.

	  Choose M to build hid-xpadneo as a module.
```
